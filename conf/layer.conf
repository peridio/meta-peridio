## conf/layer.conf
```bitbake
# We have a conf and classes directory, add to BBPATH
BBPATH .= ":${LAYERDIR}"

# We have recipes-* directories, add to BBFILES
BBFILES += "${LAYERDIR}/recipes-*/*/*.bb \
            ${LAYERDIR}/recipes-*/*/*.bbappend"

BBFILE_COLLECTIONS += "meta-peridio"
BBFILE_PATTERN_meta-peridio = "^${LAYERDIR}/"
BBFILE_PRIORITY_meta-peridio = "6"

LAYERDEPENDS_meta-peridio = "core"
LAYERSERIES_COMPAT_meta-peridio = "kirkstone"
```

## meta-peridio-agent/conf/layer.conf
```bitbake
# We have a conf and classes directory, add to BBPATH
BBPATH .= ":${LAYERDIR}"

# We have recipes-* directories, add to BBFILES
BBFILES += "${LAYERDIR}/recipes-*/*/*.bb \
            ${LAYERDIR}/recipes-*/*/*.bbappend"

BBFILE_COLLECTIONS += "peridio"
BBFILE_PATTERN_peridio = "^${LAYERDIR}/"
BBFILE_PRIORITY_peridio = "5"

# Set Yocto compat
#LAYERSERIES_COMPAT_peridio = "dunfell"
```
